## boards/shields/dosukoi4141/Kconfig.defconfig
```kconfig
if SHIELD_DOSUKOI4141_RIGHT

config ZMK_KEYBOARD_NAME
    default "dosukoi4141"

endif

if SHIELD_DOSUKOI4141_LEFT || SHIELD_DOSUKOI4141_RIGHT

config ZMK_SPLIT
    default y

endif
```

## boards/shields/dosukoi4141/Kconfig.shield
```kconfig
config SHIELD_DOSUKOI4141_LEFT
    def_bool $(shields_list_contains,dosukoi4141_left)
config SHIELD_DOSUKOI4141_RIGHT
    def_bool $(shields_list_contains,dosukoi4141_right)
```
